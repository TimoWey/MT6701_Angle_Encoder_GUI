## sdkconfig.defaults
```kconfig
# ESP32-C3 Configuration
CONFIG_IDF_TARGET="esp32c3"

# Serial Configuration
CONFIG_ESPTOOLPY_MONITOR_BAUD_115200B=y
CONFIG_ESPTOOLPY_MONITOR_BAUD=115200

# I2C Configuration
CONFIG_I2C_ENABLE_DEBUG_LOG=y

# FreeRTOS Configuration
CONFIG_FREERTOS_HZ=1000

# Log Configuration
CONFIG_LOG_DEFAULT_LEVEL_INFO=y
CONFIG_LOG_DEFAULT_LEVEL=3

# Memory Configuration
CONFIG_SPIRAM_SUPPORT=n
CONFIG_ESP32C3_DEFAULT_CPU_FREQ_160=y
CONFIG_ESP32C3_DEFAULT_CPU_FREQ_MHZ=160

# GPIO Configuration
CONFIG_GPIO_CTRL_FUNC_IN_IRAM=y
```
